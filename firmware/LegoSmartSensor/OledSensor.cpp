#include "OledSensor.h"

static const uint8_t font5x7[95][5] = {
    { 0x00, 0x00, 0x00, 0x00, 0x00 },
    { 0x00, 0x00, 0x2f, 0x00, 0x00 },
    { 0x00, 0x07, 0x00, 0x07, 0x00 },
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    { 0x02, 0x01, 0x02, 0x04, 0x02 },
};


OledSensor::OledSensor() : _i2cAddress(0x3C), _cursorCol(0), _cursorPage(0) {}

void OledSensor::sendCommand(uint8_t cmd) {
    Wire.beginTransmission(_i2cAddress);
    Wire.write(0x00);
    Wire.write(cmd);
    Wire.endTransmission();
}

void OledSensor::sendData(const uint8_t* data, size_t len) {
    // Send data in chunks of 16 to avoid buffer overflow
    for(size_t i = 0; i < len; i+=16) {
        Wire.beginTransmission(_i2cAddress);
        Wire.write(0x40); // Data stream
        size_t chunk = (len - i) > 16 ? 16 : (len - i);
        for(size_t j = 0; j < chunk; j++) {
            Wire.write(data[i+j]);
        }
        Wire.endTransmission();
    }
}

void OledSensor::setCursor(uint8_t col, uint8_t page) {
    _cursorCol = col;
    _cursorPage = page;
    sendCommand(0xB0 + (page & 0x07)); // set page
    sendCommand(0x00 + (col & 0x0F)); // lower col
    sendCommand(0x10 + ((col >> 4) & 0x0F)); // upper col
}

void OledSensor::clearDisplay() {
    uint8_t zero[16] = {0};
    for(uint8_t p = 0; p < 8; p++) {
        setCursor(0, p);
        for(uint8_t i = 0; i < 128/16; i++) {
            sendData(zero, 16);
        }
    }
    setCursor(0,0);
}

void OledSensor::printChar(char c) {
    if(c < 32 || c > 126) return;
    const uint8_t* charData = font5x7[c - 32];
    sendData(charData, 5);
    uint8_t space[1] = {0x00};
    sendData(space, 1);
    _cursorCol += 6;
    if(_cursorCol > 122) {
        _cursorCol = 0;
        _cursorPage = (_cursorPage + 1) % 8;
        setCursor(_cursorCol, _cursorPage);
    }
}

void OledSensor::begin() {
    Wire.beginTransmission(_i2cAddress);
    Wire.write(0x00);
    Wire.write(0xAE); // Display OFF
    Wire.write(0xD5); Wire.write(0x80); // Clock divide
    Wire.write(0xA8); Wire.write(0x3F); // Mux ratio 64
    Wire.write(0xD3); Wire.write(0x00); // Display offset
    Wire.write(0x40); // Start line 0
    Wire.write(0x8D); Wire.write(0x14); // Charge pump enable
    Wire.write(0x20); Wire.write(0x02); // Memory mode: Page Addressing Mode
    Wire.write(0xA1); // Segment remap
    Wire.write(0xC8); // COM scan direction
    Wire.write(0xDA); Wire.write(0x12); // COM pins hardware config
    Wire.write(0x81); Wire.write(0xCF); // Contrast
    Wire.write(0xD9); Wire.write(0xF1); // Pre-charge
    Wire.write(0xDB); Wire.write(0x40); // VCOMH
    Wire.write(0xA4); // Output follows RAM
    Wire.write(0xA6); // Normal display
    Wire.write(0xAF); // Display ON
    Wire.endTransmission();
    
    clearDisplay();
}

uint16_t OledSensor::getProductId() {
    return 530; // PRODUCT_GROUP_DEVICE_OLED
}

bool OledSensor::isConnected() {
    Wire.beginTransmission(_i2cAddress);
    return (Wire.endTransmission() == 0);
}

void OledSensor::buildNotification(uint8_t* buffer, size_t& length) {
    buffer[0] = 20; // OLED_NOTIFICATION
    buffer[1] = 1;  // Status OK
    length = 2;
}

void OledSensor::handleDataReceived(const uint8_t* payload, size_t length) {
    if (length == 0) return;
    uint8_t cmd = payload[0];
    
    if (cmd == 0x01 && length >= 4) { // Write pixel array data
        // payload[1] = col, payload[2] = page, payload[3..] = data
        uint8_t col = payload[1];
        uint8_t page = payload[2];
        setCursor(col, page);
        sendData(&payload[3], length - 3);
    } 
    else if (cmd == 0x02 && length >= 2) { // Print text
        // payload[1..] = string
        for(size_t i = 1; i < length; i++) {
            printChar((char)payload[i]);
        }
    }
    else if (cmd == 0x03) { // Start hardware scroll right
        sendCommand(0x26); // Right horizontal scroll
        sendCommand(0x00); // Dummy byte
        sendCommand(0x00); // Start page
        sendCommand(0x07); // Time interval
        sendCommand(0x07); // End page
        sendCommand(0x00); // Dummy byte
        sendCommand(0xFF); // Dummy byte
        sendCommand(0x2F); // Activate scroll
    }
    else if (cmd == 0x04) { // Stop hardware scroll
        sendCommand(0x2E); // Deactivate scroll
    }
    else if (cmd == 0x05 && length >= 3) { // Set cursor
        setCursor(payload[1], payload[2]);
    }
    else if (cmd == 0x06) { // Clear display
        clearDisplay();
    }
}
